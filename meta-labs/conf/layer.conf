## meta-labs/conf/layer.conf
```bitbake
# We have a conf and classes directory, add to BBPATH
BBPATH .= ":${LAYERDIR}"

# We have recipes-* directories, add to BBFILES
BBFILES += "${LAYERDIR}/recipes-*/*/*.bb \
            ${LAYERDIR}/recipes-*/*/*.bbappend"

BBFILE_COLLECTIONS += "meta-labs"
BBFILE_PATTERN_meta-labs = "^${LAYERDIR}/"
BBFILE_PRIORITY_meta-labs = "6"

LAYERDEPENDS_meta-labs = "core"
LAYERSERIES_COMPAT_meta-labs = "scarthgap"
```
